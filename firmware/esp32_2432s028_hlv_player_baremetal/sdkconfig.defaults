## firmware/esp32_2432s028_hlv_player_idf/main/Kconfig.projbuild
```kconfig
menu "HLV player"

    config HLV_PLAYER_DISPLAY_SPI_CLOCK_MHZ
        int "ST7789 SPI clock (MHz)"
        range 1 80
        default 80
        help
            Clock used for commands and RGB565 pixel transfers to the ST7789.
            The CYD2USB PCB may require a lower value if 80 MHz produces
            corrupted pixels or intermittent SPI errors.

    config HLV_PLAYER_SD_SPI_CLOCK_MHZ
        int "SD-card SPI clock (MHz)"
        range 1 40
        default 10
        help
            Maximum SPI clock requested from the SDSPI host after card
            initialization. The conservative 10 MHz default improves the
            timing margin on cards and PCB layouts with unreliable reads.

endmenu
```

## firmware/esp32_2432s028_uart_sweep/sdkconfig.defaults
```kconfig
CONFIG_IDF_TARGET="esp32"
CONFIG_ESPTOOLPY_FLASHMODE_QIO=y
CONFIG_ESPTOOLPY_FLASHFREQ_80M=y
CONFIG_ESPTOOLPY_FLASHSIZE_4MB=y
CONFIG_ESPTOOLPY_BEFORE_RESET=y
CONFIG_ESPTOOLPY_AFTER_RESET=y

CONFIG_ESP_DEFAULT_CPU_FREQ_MHZ_240=y
CONFIG_FREERTOS_UNICORE=y
CONFIG_COMPILER_OPTIMIZATION_SIZE=y
CONFIG_COMPILER_OPTIMIZATION_ASSERTIONS_DISABLE=y
CONFIG_LIBC_NEWLIB_NANO_FORMAT=y

CONFIG_LOG_DEFAULT_LEVEL_NONE=y
CONFIG_LOG_MAXIMUM_EQUALS_DEFAULT=y
CONFIG_BOOTLOADER_LOG_LEVEL_ERROR=y
CONFIG_ESP_CONSOLE_NONE=y
CONFIG_ESP_TASK_WDT_EN=n
CONFIG_FREERTOS_USE_TRACE_FACILITY=n
CONFIG_FREERTOS_GENERATE_RUN_TIME_STATS=n
CONFIG_FREERTOS_USE_TIMERS=n
CONFIG_ESP_MAIN_TASK_STACK_SIZE=4096
CONFIG_FREERTOS_HZ=1000
```
